## samples/net/cellular_modem/boards/mr_canhubk3.conf
```kconfig
CONFIG_MODEM_CELLULAR_APN="internet"

# Disable AT shell as SLM application has no AT mode user pipes
CONFIG_MODEM_AT_SHELL=n

CONFIG_ENTROPY_GENERATOR=y
CONFIG_TEST_RANDOM_GENERATOR=y

CONFIG_MODEM_CHAT_LOG_BUFFER_SIZE=4096
CONFIG_MODEM_CELLULAR_CMUX_MAX_FRAME_SIZE=255
CONFIG_NET_BUF_TX_COUNT=32

CONFIG_LOG_DEFAULT_LEVEL=2
CONFIG_MODEM_MODULES_LOG_LEVEL_WRN=y

# CONFIG_NET_LOG=y
# CONFIG_NET_MGMT_EVENT_LOG_LEVEL_DBG=y
# CONFIG_NET_IF_LOG_LEVEL_DBG=y

# CONFIG_NET_L2_PPP_LOG_LEVEL_DBG=y

# CONFIG_LOG_BUFFER_SIZE=8192
# CONFIG_LOG_PROCESS_THREAD_STACK_SIZE=2048

CONFIG_NET_IF_MAX_IPV4_COUNT=2
CONFIG_NET_IPV6=n
CONFIG_NET_SHELL=y

CONFIG_ASSERT=y
CONFIG_OUTPUT_DISASSEMBLY=y


CONFIG_ISR_STACK_SIZE=4096
CONFIG_NET_MGMT_EVENT_STACK_SIZE=2048
CONFIG_NET_L2_PPP_TX_STACK_SIZE=2048
CONFIG_NET_CONNECTION_MANAGER_MONITOR_STACK_SIZE=1024
CONFIG_DNS_RESOLVER_LOG_LEVEL_DBG=y
```
